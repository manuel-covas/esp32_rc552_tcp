## main/Kconfig.projbuild
```kconfig
menu "ESP32_RC522 Configuration"

    config WIFI_SSID
        string "WiFi SSID"
        default "myssid"
        help
            SSID (network name) to connect to.

    config WIFI_PASSWORD
        string "WiFi Password"
        default "mypassword"
        help
            WiFi password (WPA or WPA2) to use.

    choice SCAN_METHOD
        prompt "Scan method"
        default WIFI_FAST_SCAN
        help
            scan method for the esp32 to use

        config WIFI_FAST_SCAN
            bool "fast"
        config WIFI_ALL_CHANNEL_SCAN
            bool "all"
    endchoice

    choice SORT_METHOD
        prompt "sort method"
        default WIFI_CONNECT_AP_BY_SIGNAL
        help
            sort method for the esp32 to use

        config WIFI_CONNECT_AP_BY_SIGNAL
            bool "rssi"
        config WIFI_CONNECT_AP_BY_SECURITY
            bool "authmode"
    endchoice

    config FAST_SCAN_THRESHOLD
        bool "fast scan threshold"
        default y
        help
            wifi fast scan threshold

    config FAST_SCAN_MINIMUM_SIGNAL
        int "fast scan minimum rssi"
        depends on FAST_SCAN_THRESHOLD
        range -127 0
        default -127
        help
            rssi is use to measure the signal

    choice FAST_SCAN_WEAKEST_AUTHMODE
        prompt "fast scan weakest authmode"
        depends on FAST_SCAN_THRESHOLD
        default FAST_SCAN_WEAKEST_AUTHMODE_OPEN

        config FAST_SCAN_WEAKEST_AUTHMODE_OPEN
            bool "open"
        config FAST_SCAN_WEAKEST_AUTHMODE_WEP
            bool "wep"
        config FAST_SCAN_WEAKEST_AUTHMODE_WPA
            bool "wpa"
        config FAST_SCAN_WEAKEST_AUTHMODE_WPA2
            bool "wpa2"
    endchoice


    config DESTINATION_ADDRESS
        string "Destination IPV4 Address"
        default "X.X.X.X"
        help
            Address to connect and make the RC522 available to.

    config DESTINATION_PORT
        int "Destination port"
        default 45000
        help
            Port to connect and make the RC522 available to.


    config SPI_CLK_GPIO_NUM
        int "SPI CLK GPIO number"
        default 14
	help
            GPIO number to use for SPI clock.

    config SPI_MISO_GPIO_NUM
        int "SPI MISO GPIO number"
        default 12
	help
            GPIO number to use for SPI MISO.

    config SPI_MOSI_GPIO_NUM
        int "SPI MOSI GPIO number"
        default 13
	help
            GPIO number to use for SPI MOSI.


    config CS_GPIO_NUM
        int "RC522 CS pin GPIO number"
        default 26
	help
            GPIO number where the RC522 RST pin is connected to.

    config RST_GPIO_NUM
        int "RC522 RST pin GPIO number"
        default 27
	help
            GPIO number where the RC522 RST pin is connected to.

endmenu
```
